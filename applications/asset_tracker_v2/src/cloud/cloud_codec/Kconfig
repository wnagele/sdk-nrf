## applications/asset_tracker_v2/src/cloud/cloud_codec/Kconfig
```kconfig
#
# Copyright (c) 2021 Nordic Semiconductor
#
# SPDX-License-Identifier: LicenseRef-Nordic-5-Clause
#

menuconfig CLOUD_CODEC
	bool "Application cloud codec"
	default y

if CLOUD_CODEC

choice
	prompt "Application cloud codec backend"
	default CLOUD_CODEC_NRF_CLOUD if NRF_CLOUD_MQTT

config CLOUD_CODEC_NRF_CLOUD
	bool "Enable nRF Cloud codec backend"
	help
	  The nRF Cloud codec backend uses the nRF Cloud cell position library to
	  generate a JSON cell position request based on neighbor cell measurements.

endchoice

config CLOUD_CODEC_APN_LEN_MAX
	int "Maximum length of APN"
	default 30
	help
	  Maximum length of APN (Access Point Name).

module = CLOUD_CODEC
module-str = Cloud codec
source "subsys/logging/Kconfig.template.log_config"

endif # CLOUD_CODEC #
```

## applications/asset_tracker_v2/src/modules/Kconfig.debug_module
```kconfig
#
# Copyright (c) 2021 Nordic Semiconductor
#
# SPDX-License-Identifier: LicenseRef-Nordic-5-Clause
#

menuconfig DEBUG_MODULE
	bool "Debug module"

module = DEBUG_MODULE
module-str = Debug module
source "subsys/logging/Kconfig.template.log_config"
```
